#include "cirque_split.dtsi"

&pro_micro_i2c {
    status = "okay";

    glidepoint: glidepoint@2a {
        compatible = "cirque,pinnacle";
        reg = <0x2a>;
        status = "okay";
        dr-gpios = <&pro_micro 1 (GPIO_ACTIVE_HIGH)>;
        sensitivity = "2x";
        rotate-90;
        y-invert;
    };
};

&glidepoint_split {
    device = <&glidepoint>;
};
